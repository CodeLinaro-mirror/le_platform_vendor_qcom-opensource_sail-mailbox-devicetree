/*
* Copyright (c) Qualcomm Technologies, Inc. and/or its subsidiaries.
*  SPDX-License-Identifier: BSD-3-Clause
*/
 
/dts-v1/;
 /plugin/;

#include "qcs8275-addons-iq-8275-evk.dtsi"
/ {
	model = "Qualcomm Technologies, Inc. IQ8 8275 Pro SKU EVK";
        compatible = "qcom,qcs8275-iq-8275-evk-pro-sku", "qcom,qcs8275", "qcom,qcs8300";

};

